## CMakeLists.txt
```
include($ENV{ZEPHYR_BASE}/cmake/app/boilerplate.cmake NO_POLICY_SCOPE)
project(NONE)

file(GLOB SRCS "src/*.c")
target_include_directories(app PRIVATE $ENV{ZEPHYR_BASE}/drivers)
target_include_directories(app PRIVATE hdr)
target_sources(app PRIVATE ${SRCS})


target_compile_definitions(app PRIVATE THREAD)
```

## prj.conf
```kconfig
#CONFIG_STDOUT_CONSOLE=y
CONFIG_PRINTK=y
CONFIG_ARC_INIT=y
CONFIG_THREAD_CUSTOM_DATA=y
CONFIG_IPM=y
CONFIG_IPM_QUARK_SE=y
CONFIG_IPM_QUARK_SE_MASTER=y
CONFIG_IPM_CONSOLE_SENDER=y
CONFIG_TIMESLICE_SIZE=1
CONFIG_GPIO=y
#CONFIG_CONSOLE=y
#CONFIG_SERIAL=y
CONFIG_SPI=y

CONFIG_BT=y
CONFIG_BT_PERIPHERAL=y
```

## src/main.c
```c
#include <zephyr.h>
#include <misc/printk.h>
#include <kernel.h>
#include <device.h>
#include <ipm.h>
#include <ipm/ipm_quark_se.h>
#include <gpio.h>
#include <spi.h>

#include <bluetooth/bluetooth.h>
#include <bluetooth/hci.h>
#include <bluetooth/uuid.h>
#include <bluetooth/gatt.h>
#include <misc/byteorder.h>

#include <stdio.h>
#include <string.h>

#include "OLED.h"

#define STACKSIZE	8092
#define PRIORITY	1

#define DEVICE_NAME 		"Infomation"
#define DEVICE_NAME_LEN 	(sizeof(DEVICE_NAME) - 1)
#define TEMPERATURE_CUD		"Temperature"
#define HUMIDITY_CUD		"Humidity"
#define BATTERY_CUD			"Battery"

static s16_t gTempValue;
static u16_t gHumidityValue;
static u16_t gBatteryValue;

void DHT11Report(void);
void OLEDProc(void);
void IPMProc(void);

K_THREAD_DEFINE(kDHT11_ID, STACKSIZE, DHT11Report, NULL, NULL, NULL,
		PRIORITY , 0, K_NO_WAIT);

K_THREAD_DEFINE(kOLED_ID, STACKSIZE, OLEDProc, NULL, NULL, NULL,
		PRIORITY , 0, K_NO_WAIT);

K_THREAD_DEFINE(kIPM_ID, STACKSIZE, IPMProc, NULL, NULL, NULL,
		PRIORITY , 0, K_NO_WAIT);

struct DHT11Data
{
	void* reserved;
	u8_t temp;
	u8_t humi;
};

struct StringData
{
	void* reserved;
	char str[10][17];
};

K_FIFO_DEFINE(kDHT11_FIFO);
K_FIFO_DEFINE(kTEXT_FIFO);

void DHT11Report(void)
{
	k_sleep(1100);
	printk("x86\n");

	struct device* gpio_dev;

	gpio_dev = device_get_binding("GPIO_0");
	if (!gpio_dev)
	{
		printk("cannot find %s\n", "GPIO_0");
		return;
	}

	/* capture initial time stamp */

	/* do work for some (short) period of time */
	/* capture final time stamp */

	 // k_busy_wait call takes 5us
	 // configure call takes 10us 
	 // read/write call takes 3us

	while (1)
	{
		gpio_pin_configure(gpio_dev, 19, (GPIO_DIR_OUT));
		gpio_pin_write(gpio_dev, 19, 1);
		k_sleep(1000);
		gpio_pin_write(gpio_dev, 19, 0);
		k_busy_wait(18000 - 3);
		gpio_pin_configure(gpio_dev, 19, (GPIO_DIR_IN));
		k_busy_wait(25);

		u32_t val1, val2;
		// verifiy
		gpio_pin_read(gpio_dev, 19, &val1);
		k_busy_wait(72);
		gpio_pin_read(gpio_dev, 19, &val2);
		k_busy_wait(72);

		if (val1 != 0 || val2 != 1)
		{
			printk("check fail\n");
			continue;
		}

		u8_t result[5] = {0, };
		for (int b = 0; b < 5; b++)
		{
			for (int i = 0; i < 8; i++)
			{
				u32_t val;
				u16_t cnt = 0;
				do
				{
					gpio_pin_read(gpio_dev, 19, &val);
				} while (val == 0 && cnt++ < 300);
				k_busy_wait(30);
				// read data
				gpio_pin_read(gpio_dev, 19, &val);

				if (val == 1)
				{
					result[b] |= (1 << (7 - i));
				}

				cnt = 0;
				do
				{
					gpio_pin_read(gpio_dev, 19, &val);
				} while (val == 1 && cnt++ < 300);
			}
		}
		
		u8_t checksum = 0;
		for (int i = 0; i < 4; i++)
		{
			// test
			checksum += result[i];
		}

		if (checksum == result[4])
		{
			printk("TEMP : %d C, HUMI : %d %%\n", result[2], result[0]);
			static struct DHT11Data dht11;
			dht11.temp = result[2];
			dht11.humi = result[0];
			gTempValue = dht11.temp;
			gHumidityValue = dht11.humi;
			k_fifo_put(&kDHT11_FIFO, &dht11);
		}
		else
		{
			printk("check sum fail\n");
		}

		k_sleep(1000);
	}
}

void OLEDProc(void)
{
	k_sleep(370);

	InitOLED();
	CommandOLED(0xaf);
	k_sleep(300);
	CommandOLED(0xa0);
	DataOLED(0b10110000);

	ScrollVertical(32);

	CommandOLED(0xb2);
	DataOLED(0xa4);
	DataOLED(0x00);
	DataOLED(0x00);

	DrawRect(0, 0, 128, 128, 0, 0, 0);
	k_sleep(500);

	static char buf[17];
	while(1)
	{
		struct DHT11Data* data = k_fifo_get(&kDHT11_FIFO, K_NO_WAIT);
		if (data != NULL)
		{
			sprintf(buf, "%d C %d %%", data->temp, data->humi);
			DrawString(0, 0, 0, 127, 0, buf);
		}
		else
		{
			printk("dht11 is null\n");
		}
		struct StringData* strData = k_fifo_get(&kTEXT_FIFO, K_NO_WAIT);
		if (strData != NULL)
		{
			for (int i = 0; i < 10; i++)
			{
				sprintf(buf, "%s", strData->str[i]);
				DrawString(0, (i + 1) * 11, 0, 127, 0, buf);
			}
		}
		else
		{
			printk("bat is null\n");
		}
		k_sleep(1000);
	}
}

QUARK_SE_IPM_DEFINE(ess_ipm, 0, QUARK_SE_IPM_INBOUND);

static void sensor_ipm_callback(void* context, u32_t id, volatile void* data)
{
	volatile u32_t val = *(u32_t*)data;

	gBatteryValue = val;
	static struct StringData strData;
	sprintf(strData.str[0], "%3d%%", val);
	k_fifo_put(&kTEXT_FIFO, &strData);
}

void IPMProc(void)
{
	struct device* ipm;
	ipm = device_get_binding("ess_ipm");
	ipm_register_callback(ipm, sensor_ipm_callback, NULL);
	ipm_set_enabled(ipm, 1);

	k_sleep(K_FOREVER);
}

void BluetoothProc(void);
K_THREAD_DEFINE(kBLUETOOTH_ID, STACKSIZE, BluetoothProc, NULL, NULL, NULL,
		PRIORITY , 0, K_NO_WAIT);

static ssize_t ReadU16(struct bt_conn* conn, const struct bt_gatt_attr* attr,
	void* buf, u16_t len, u16_t offset)
{
	const u16_t* u16 = attr->user_data;
	u16_t value = sys_cpu_to_be16(*u16);
	return bt_gatt_attr_read(conn, attr, buf, len, offset, &value, sizeof(value));
}

static struct bt_uuid_128 gBatteryUUID = BT_UUID_INIT_128(
	0xf0, 0xde, 0xbc, 0x9a, 0x78, 0x56, 0x34, 0x12,
	0x78, 0x56, 0x34, 0x12, 0x78, 0x56, 0x34, 0x12
);

static struct bt_gatt_attr gAttrs[] = 
{
	BT_GATT_PRIMARY_SERVICE(BT_UUID_ESS),

	BT_GATT_CHARACTERISTIC(BT_UUID_TEMPERATURE, BT_GATT_CHRC_READ),
	BT_GATT_DESCRIPTOR(BT_UUID_TEMPERATURE, BT_GATT_PERM_READ, 
		ReadU16, NULL, &gTempValue),
	BT_GATT_CUD(TEMPERATURE_CUD, BT_GATT_PERM_READ),

	BT_GATT_CHARACTERISTIC(BT_UUID_HUMIDITY, BT_GATT_CHRC_READ),
	BT_GATT_DESCRIPTOR(BT_UUID_HUMIDITY, BT_GATT_PERM_READ, 
		ReadU16, NULL, &gHumidityValue),
	BT_GATT_CUD(HUMIDITY_CUD, BT_GATT_PERM_READ),

	BT_GATT_CHARACTERISTIC(&gBatteryUUID.uuid, BT_GATT_CHRC_READ),
	BT_GATT_DESCRIPTOR(&gBatteryUUID.uuid, BT_GATT_PERM_READ, 
	ReadU16, NULL, &gBatteryValue),
	BT_GATT_CUD(BATTERY_CUD, BT_GATT_PERM_READ),
};

static struct bt_gatt_service gEnvSvc = BT_GATT_SERVICE(gAttrs);

static const struct bt_data gAD[] = 
{
	BT_DATA_BYTES(BT_DATA_FLAGS, (BT_LE_AD_GENERAL | BT_LE_AD_NO_BREDR)),
};

static struct bt_data gSD[] = 
{
	BT_DATA(BT_DATA_NAME_COMPLETE, DEVICE_NAME, DEVICE_NAME_LEN),
};

static void BluetoothReady(int err)
{
	if (err)
	{
		printk("Bluetooth init failed err=%d\n", err);
		return;
	}

	bt_gatt_service_register(&gEnvSvc);

	err = bt_le_adv_start(BT_LE_ADV_CONN, gAD, ARRAY_SIZE(gAD),
		gSD, ARRAY_SIZE(gSD));
	
	if (err)
	{
		printk("Advertising failed to start err=%d\n", err);
		return;
	}
}

void BluetoothProc(void)
{
	int rc = bt_enable(BluetoothReady);
	if (rc)
	{
		printk("Bluetooth init failed rc=%d\n", rc);
		return;
	}

	k_sleep(K_FOREVER);
}
```

## src/OLED.c
```c
#include <zephyr.h>
#include <gpio.h>
#include <spi.h>

#include <string.h>

#include "OLED.h"

#define OLED_SPI_INIT_FAIL		-0x01
#define OLED_SPI_CONFIG_FAIL	-0x02
#define OLED_SPI_SELECT_FAIL	-0x03
#define OLED_SPI_WRITE_FAIL		-0x04

#define OLED_GPIO_INIT_FAIL		-0x11
#define OLED_GPIO_CONFIG_FAIL	-0x12

#define OLED_DC_PIN 16
#define OLED_RES_PIN 20

static struct device *GPIODevice;
static struct device *SPIDevice;
struct spi_config SPIConfig = {
	.config = SPI_MODE_CPOL | SPI_MODE_CPHA |  SPI_WORD(8),
	.max_sys_freq = 2,
};

int InitOLED()
{
	int err;
	SPIDevice = device_get_binding("SPI_1");
	if (!SPIDevice)
	{
		printk("spi get fail\n");
		return OLED_SPI_INIT_FAIL;
	}

	err = spi_configure(SPIDevice, &SPIConfig);
	if (err)
	{
		return OLED_SPI_CONFIG_FAIL;
	}

	err = spi_slave_select(SPIDevice, 1);
	if (err)
	{
		return OLED_SPI_SELECT_FAIL;
	}


	GPIODevice = device_get_binding("GPIO_0");
	if (!GPIODevice)
	{
		return OLED_GPIO_INIT_FAIL;
	}

	// configure
	if (gpio_pin_configure(GPIODevice, OLED_DC_PIN, (GPIO_DIR_OUT)) ||
		gpio_pin_configure(GPIODevice, OLED_RES_PIN, (GPIO_DIR_OUT)))
	{
		return OLED_GPIO_CONFIG_FAIL;
	}

	// power on
	gpio_pin_write(GPIODevice, OLED_RES_PIN, 0);
	gpio_pin_write(GPIODevice, OLED_RES_PIN, 1);

	gpio_pin_write(GPIODevice, OLED_DC_PIN, 1);
	return 0;
}

int WriteOLED(u8_t data, u32_t flag)
{
	gpio_pin_write(GPIODevice, OLED_DC_PIN, flag);

	if (spi_write(SPIDevice, &data, 1))
	{
		return OLED_SPI_WRITE_FAIL;
	}
	return 0;
}

int CommandOLED(u8_t cmd)
{
	return WriteOLED(cmd, 0);
}

int DataOLED(u8_t data)
{
	return WriteOLED(data, 1);
}

int ScrollVertical(u8_t n)
{
	CommandOLED(0xa1);
	DataOLED(n);
	return 0;
}

// dir -1 : right, 0 : stop, 1 : left
// start : start row
// num : number of rows
// speed 0 : fast, 1 : normal, 2 : slow, 3 : slowest
int ScrollHorizontal(u8_t dir, u8_t start, u8_t num, u8_t speed)
{
	CommandOLED(0x96);
	DataOLED(dir);
	DataOLED(start);
	DataOLED(num);
	DataOLED(0);
	DataOLED(speed);
	return 0;
}

int StartScrollHorizontal()
{
	CommandOLED(0x9f);
	return 0;
}

int StopScrollHorizontal()
{
	CommandOLED(0x9e);
	return 0;
}

// 0 : all off, 1 : all on, 2 : reset normal display, 3 : inverse
int SetDisplayMode(u8_t mode)
{
	if (mode > 3) return -1;
	CommandOLED(0xa4 | mode);
	return 0;
}

// 0 : sleep, 1 : wakeup
int  SetSleepMode(u8_t mode)
{
	if (mode > 1) return -1;
	CommandOLED(0xae | mode);
	return 0;
}

int SetCursor(u8_t x, u8_t y, u8_t w, u8_t h)
{
	CommandOLED(0x15);
	DataOLED(x);
	DataOLED(x + w - 1);

	CommandOLED(0x75);
	DataOLED(y);
	DataOLED(y + h - 1);
	return 0;
}

int DrawRect(u8_t x, u8_t y, u8_t w, u8_t h,
			u8_t r, u8_t g, u8_t b)
{
	SetCursor(x, y, w, h);
	CommandOLED(0x5c);

	for (int x = 0; x < w; x++)
	{
		for (int y = 0; y < h; y++)
		{
			DataOLED(b);
			DataOLED(g);
			DataOLED(r);
		}
	}
	return 0;
}

int DrawChar(u8_t x, u8_t y, u8_t r, u8_t g, u8_t b, char c)
{
	SetCursor(x, y, 8, 11);
	CommandOLED(0x5c);

	int i = c * 11;
	for (int y = 0; y < 11; y++)
	{
		for (int x = 0; x < 8; x++)
		{
			if ((CharMap[i] & (1 << x)) != 0)
			{
				DataOLED(b);
				DataOLED(g);
				DataOLED(r);
			}
			else
			{
				DataOLED(0);
				DataOLED(0);
				DataOLED(0);
			}
		}
		i++;
	}
	return 0;
}

int DrawString(u8_t x, u8_t y, u8_t r, u8_t g, u8_t b, const char* str)
{
	for (int i = 0; i < strlen(str); i++)
	{
		DrawChar(x + (i * 8), y, r, g, b, str[i]);
	}
	return 0;
}

const u8_t CharMap[1408] =
{
	0,0,0,0,0,0,0,0,0,0,0,
	0,0,0,0,0,0,0,0,0,0,0,
	0,0,0,0,0,0,0,0,0,0,0,
	0,0,0,0,0,0,0,0,0,0,0,
	0,0,0,0,0,0,0,0,0,0,0,
	0,0,0,0,0,0,0,0,0,0,0,
	0,0,0,0,0,0,0,0,0,0,0,
	0,0,0,0,0,0,0,0,0,0,0,
	0,0,0,0,0,0,0,0,0,0,0,
	0,0,0,0,0,0,0,0,0,0,0,

	0,0,0,0,0,0,0,0,0,0,0,
	0,0,0,0,0,0,0,0,0,0,0,
	0,0,0,0,0,0,0,0,0,0,0,
	0,0,0,0,0,0,0,0,0,0,0,
	0,0,0,0,0,0,0,0,0,0,0,
	0,0,0,0,0,0,0,0,0,0,0,
	0,0,0,0,0,0,0,0,0,0,0,
	0,0,0,0,0,0,0,0,0,0,0,
	0,0,0,0,0,0,0,0,0,0,0,
	0,0,0,0,0,0,0,0,0,0,0,

	0,0,0,0,0,0,0,0,0,0,0,
	0,0,0,0,0,0,0,0,0,0,0,
	0,0,0,0,0,0,0,0,0,0,0,
	0,0,0,0,0,0,0,0,0,0,0,
	0,0,0,0,0,0,0,0,0,0,0,
	0,0,0,0,0,0,0,0,0,0,0,
	0,0,0,0,0,0,0,0,0,0,0,
	0,0,0,0,0,0,0,0,0,0,0,
	0,0,0,0,0,0,0,0,0,0,0,
	0,0,0,0,0,0,0,0,0,0,0,

	0,0,0,0,0,0,0,0,0,0,0,
	0,0,0,0,0,0,0,0,0,0,0,
	0,0,0,0,0,0,0,0,0,0,0,          //
	12,30,30,30,12,12,0,12,12,0,0,  // !
	54,54,20,0,0,0,0,0,0,0,0,       // "
	0,18,18,63,18,18,63,18,18,0,0,  // #
	12,30,51,3,30,48,51,30,12,12,0, // $
	0,0,35,51,24,12,6,51,49,0,0,    // %
	12,30,30,12,54,27,27,27,54,0,0, // &
	12,12,6,0,0,0,0,0,0,0,0,        // '
	24,12,6,6,6,6,6,12,24,0,0,      // (
	6,12,24,24,24,24,24,12,6,0,0,   // )
	0,0,0,51,30,63,30,51,0,0,0,     // *
	0,0,0,12,12,63,12,12,0,0,0,     // +
	0,0,0,0,0,0,0,12,12,6,0,        // ,
	0,0,0,0,0,63,0,0,0,0,0,         // -
	0,0,0,0,0,0,0,12,12,0,0,        // .    
	0,0,32,48,24,12,6,3,1,0,0,      // /

	12,30,51,51,51,51,51,30,12,0,0, // 0
	12,14,15,12,12,12,12,12,63,0,0, // 1
	30,51,48,24,12,6,3,51,63,0,0,   // 2
	30,51,48,48,28,48,48,51,30,0,0, // 3
	16,24,28,26,25,63,24,24,60,0,0, // 4
	63,3,3,31,48,48,48,51,30,0,0,   // 5
	28,6,3,3,31,51,51,51,30,0,0,    // 6
	63,49,48,48,24,12,12,12,12,0,0, // 7
	30,51,51,51,30,51,51,51,30,0,0, // 8
	30,51,51,51,62,48,48,24,14,0,0, // 9

	0,0,12,12,0,0,12,12,0,0,0,      // :
	0,0,12,12,0,0,12,12,6,0,0,      // ;
	0,0,24,12,6,3,6,12,24,0,0,      // <
	0,0,0,63,0,0,63,0,0,0,0,        // =
	0,0,3,6,12,24,12,6,3,0,0,       // >
	30,51,51,59,59,59,27,3,30,0,0,  // @
	30,51,51,24,12,12,0,12,12,0,0,  // ?

	12,30,51,51,63,51,51,51,51,0,0,          // A ** TO BE FILLED **
	31,51,51,51,31,51,51,51,31,0,0, // B
	28,54,35,3,3,3,35,54,28,0,0,    // C
	15,27,51,51,51,51,51,27,15,0,0, // D
	63,51,35,11,15,11,35,51,63,0,0, // E
	63,51,35,11,15,11,3,3,3,0,0,    // F
	28,54,35,3,59,51,51,54,44,0,0,  // G
	51,51,51,51,63,51,51,51,51,0,0, // H
	30,12,12,12,12,12,12,12,30,0,0, // I
	60,24,24,24,24,24,27,27,14,0,0, // J
	51,51,51,27,15,27,51,51,51,0,0, // K
	3,3,3,3,3,3,35,51,63,0,0,       // L
	33,51,63,63,51,51,51,51,51,0,0, // M
	51,51,55,55,63,59,59,51,51,0,0, // N
	30,51,51,51,51,51,51,51,30,0,0, // O
	31,51,51,51,31,3,3,3,3,0,0,     // P
	30,51,51,51,51,51,63,59,30,48,0,// Q
	31,51,51,51,31,27,51,51,51,0,0, // R
	30,51,51,6,28,48,51,51,30,0,0,  // S
	63,63,45,12,12,12,12,12,30,0,0, // T
	51,51,51,51,51,51,51,51,30,0,0, // U
	51,51,51,51,51,30,30,12,12,0,0, // V
	51,51,51,51,51,63,63,63,18,0,0, // W
	51,51,30,30,12,30,30,51,51,0,0, // X
	51,51,51,51,30,12,12,12,30,0,0, // Y
	63,51,49,24,12,6,35,51,63,0,0,  // Z

	30,6,6,6,6,6,6,6,30,0,0,          // [
	0,0,1,3,6,12,24,48,32,0,0,        // "\"
	30,24,24,24,24,24,24,24,30,0,0,   // ]
	8,28,54,0,0,0,0,0,0,0,0,          // ^
	0,0,0,0,0,0,0,0,0,63,0,           // _
	6,12,24,0,0,0,0,0,0,0,0,          // `

	0,0,0,14,24,30,27,27,54,0,0,      // a
	3,3,3,15,27,51,51,51,30,0,0,      // b
	0,0,0,30,51,3,3,51,30,0,0,        // c
	48,48,48,60,54,51,51,51,30,0,0,  // d
	0,0,0,30,51,63,3,51,30,0,0,      // e
	28,54,38,6,15,6,6,6,15,0,0,      // f
	0,0,30,51,51,51,62,48,51,30,0,   // g
	3,3,3,27,55,51,51,51,51,0,0,     // h
	12,12,0,14,12,12,12,12,30,0,0,   // i
	48,48,0,56,48,48,48,48,51,30,0,  // j
	3,3,3,51,27,15,15,27,51,0,0,     // k
	14,12,12,12,12,12,12,12,30,0,0,  // l
	0,0,0,29,63,43,43,43,43,0,0,     // m
	0,0,0,29,51,51,51,51,51,0,0,     // n
	0,0,0,30,51,51,51,51,30,0,0,     // o
	0,0,0,30,51,51,51,31,3,3,0,      // p
	0,0,0,30,51,51,51,62,48,48,0,    // q
	0,0,0,29,55,51,3,3,7,0,0,        // r
	0,0,0,30,51,6,24,51,30,0,0,      // s
	4,6,6,15,6,6,6,54,28,0,0,        // t
	0,0,0,27,27,27,27,27,54,0,0,     // u
	0,0,0,51,51,51,51,30,12,0,0,     // v
	0,0,0,51,51,51,63,63,18,0,0,     // w
	0,0,0,51,30,12,12,30,51,0,0,     // x
	0,0,0,51,51,51,62,48,24,15,0,    // y
	0,0,0,63,27,12,6,51,63,0,0,      // z

	56,12,12,12,7,12,12,12,56,0,0,   // {
	12,12,12,12,12,12,12,12,12,0,0,  // |
	7,12,12,12,56,12,12,12,7,0,0,    // }
	38,45,25,0,0,0,0,0,0,0,0,        // ~
};
```
