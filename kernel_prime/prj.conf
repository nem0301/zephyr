## CMakeLists.txt
```
include($ENV{ZEPHYR_BASE}/cmake/app/boilerplate.cmake NO_POLICY_SCOPE)
project(NONE)

file(GLOB SRCS "src/*.c")
target_include_directories(app PRIVATE hdr)
target_sources(app PRIVATE ${SRCS})
```

## prj.conf
```kconfig
CONFIG_PRINTK=y
CONFIG_TIMESLICING=y
CONFIG_TIMESLICE_SIZE=100
CONFIG_TIMESLICE_PRIORITY=7
CONFIG_THREAD_CUSTOM_DATA=y
CONFIG_HEAP_MEM_POOL_SIZE=4112
```

## src/main.c
```c
#include "Common.h"

// work queue
#include "WorkQueue.h"
// kernel timer
#include "Timer.h"

int main()
{
	InitTimer();
	InitWorkQueue();

	while(1)
	{
		k_sleep(10000);
	}
}
```

## src/DataPassing.c
```c
#include "Common.h"
#include "DataPassing.h"

struct data_item_t
{
	void* reserved;
	int value;
};

#ifdef DATA_FIFO
K_THREAD_DEFINE(kFifo1ID, STACKSIZE, Fifo1Thread, NULL, NULL, NULL,
		PRIORITY, 0, K_NO_WAIT);
K_THREAD_DEFINE(kFifo2ID, STACKSIZE, Fifo2Thread, NULL, NULL, NULL,
		PRIORITY, 0, K_NO_WAIT);
K_THREAD_DEFINE(kFifo3ID, STACKSIZE, Fifo3Thread, NULL, NULL, NULL,
		PRIORITY, 0, K_NO_WAIT);
#endif
K_FIFO_DEFINE(kMyFifo);

#ifdef DATA_LIFO
K_THREAD_DEFINE(kLifo1ID, STACKSIZE, Lifo1Thread, NULL, NULL, NULL,
		PRIORITY, 0, K_NO_WAIT);
K_THREAD_DEFINE(kLifo2ID, STACKSIZE, Lifo2Thread, NULL, NULL, NULL,
		PRIORITY, 0, K_NO_WAIT);
K_THREAD_DEFINE(kLifo3ID, STACKSIZE, Lifo3Thread, NULL, NULL, NULL,
		PRIORITY, 0, K_NO_WAIT);
#endif
K_LIFO_DEFINE(kMyLifo);

#ifdef DATA_STACK
K_THREAD_DEFINE(kStack1ID, STACKSIZE, Stack1Thread, NULL, NULL, NULL,
		PRIORITY, 0, K_NO_WAIT);
K_THREAD_DEFINE(kStack2ID, STACKSIZE, Stack2Thread, NULL, NULL, NULL,
		PRIORITY, 0, K_NO_WAIT);
#endif
K_STACK_DEFINE(kMyStack, 10);

#ifdef DATA_MESSAGE
K_THREAD_DEFINE(kMessage1ID, STACKSIZE, Message1Thread, NULL, NULL, NULL,
		PRIORITY, 0, K_NO_WAIT);
K_THREAD_DEFINE(kMessage2ID, STACKSIZE, Message2Thread, NULL, NULL, NULL,
		PRIORITY, 0, K_NO_WAIT);
#endif
struct msgq_item_t
{
	u32_t filed1;
	u32_t filed2;
};
K_MSGQ_DEFINE(kMyMsgq, sizeof(struct msgq_item_t), 10, 4);

#ifdef DATA_MAILBOX
K_THREAD_DEFINE(kMailBox1ID, STACKSIZE, MailBox1Thread, NULL, NULL, NULL,
		PRIORITY, 0, K_NO_WAIT);
K_THREAD_DEFINE(kMailBox2ID, STACKSIZE, MailBox2Thread, NULL, NULL, NULL,
		PRIORITY, 0, K_NO_WAIT);
K_THREAD_DEFINE(kMailBox3ID, STACKSIZE, MailBox3Thread, NULL, NULL, NULL,
		PRIORITY, 0, K_NO_WAIT);
#endif

#ifdef DATA_PIPE
K_THREAD_DEFINE(kPipe1ID, STACKSIZE, Pipe1Thread, NULL, NULL, NULL,
		PRIORITY, 0, K_NO_WAIT);
K_THREAD_DEFINE(kPipe2ID, STACKSIZE, Pipe2Thread, NULL, NULL, NULL,
		PRIORITY, 0, K_NO_WAIT);
#endif


void Fifo1Thread()
{
	struct data_item_t data;
	data.value = 1;
	while (1)
	{
		printk("thread1 put fifo %d\n", data.value);
		k_fifo_put(&kMyFifo, &data);
		k_sleep(1000);
	}
}

void Fifo2Thread()
{
	struct data_item_t data;
	data.value = 2;
	while (1)
	{
		printk("thread2 put fifo %d\n", data.value);
		k_fifo_put(&kMyFifo, &data);
		k_sleep(1000);
	}
}

void Fifo3Thread()
{
	while (1)
	{
		struct data_item_t* data = k_fifo_get(&kMyFifo, K_FOREVER);
		printk("thread3 get fifo %d\n", data->value);
		k_sleep(500);
	}
}

void Lifo1Thread()
{
	struct data_item_t data;
	data.value = 1;
	while (1)
	{
		printk("thread1 put lifo %d\n", data.value);
		k_lifo_put(&kMyLifo, &data);
		k_sleep(1000);
	}
}

void Lifo2Thread()
{
	struct data_item_t data;
	data.value = 2;
	while (1)
	{
		printk("thread2 put lifo %d\n", data.value);
		k_lifo_put(&kMyLifo, &data);
		k_sleep(1000);
	}
}

void Lifo3Thread()
{
	while (1)
	{
		struct data_item_t* data = k_lifo_get(&kMyLifo, K_FOREVER);
		printk("thread3 get lifo %d\n", data->value);
		k_sleep(500);
	}
}


void Stack1Thread()
{
	int buffer[10];
	for (int i = 0; i < 10; i++)
	{
		buffer[i] = i;
		k_stack_push(&kMyStack, (u32_t)&buffer[i]);
	}
	while (1)
	{
		k_sleep(1000);
	}
}

void Stack2Thread()
{
	while (1)
	{
		int* data;
		k_stack_pop(&kMyStack, (u32_t*)&data, K_FOREVER);
		printk("data=%d\n", *data);
		k_sleep(1000);
	}
}

// msgq is to copy data. async
void Message1Thread()
{
	struct msgq_item_t data;
	memset(&data, 0, sizeof(struct msgq_item_t));
	while (1)
	{
		data.filed1 += 1;
		data.filed2 += 2;

		printk("megq1 = %d %d\n", data.filed1, data.filed2);
		while (k_msgq_put(&kMyMsgq, &data, K_NO_WAIT))
		{
			k_msgq_purge(&kMyMsgq);
		}

		k_sleep(500);
	}
}

void Message2Thread()
{
	struct msgq_item_t data;
	while (1)
	{
		k_msgq_get(&kMyMsgq, &data, K_FOREVER);
		printk("megq2 = %d %d\n", data.filed1, data.filed2);
		k_sleep(1000);
	}
}

K_MBOX_DEFINE(kMyMailBox);

K_SEM_DEFINE(kMySemMBox, 1, 1);

K_MEM_POOL_DEFINE(kMyPoolMBox, 4096, 4096, 2, 2);

void MailBox1Thread()
{
	char buffer[100];
	char text[100] = "text is not empty";
	int size = 10;

	struct k_mbox_msg sendMsg;
	struct k_mbox_msg sendMsg2;

	char hwBuffer[4096];

	while (1)
	{
		memset(&sendMsg, 0, sizeof(sendMsg));
		memset(&sendMsg2, 0, sizeof(sendMsg2));

		printk("th1 try to take sem\n");
		if (!k_sem_take(&kMySemMBox, K_NO_WAIT))
		{
			k_mem_pool_alloc(&kMyPoolMBox, &sendMsg2.tx_block, 4096, K_FOREVER);

			memcpy(sendMsg2.tx_block.data, hwBuffer, 4096);

			sendMsg2.size = 4096;
#ifdef DATA_MAILBOX
			sendMsg2.tx_target_thread = kMailBox3ID;
#endif

			printk("th1 async put\n");
			k_mbox_async_put(&kMyMailBox, &sendMsg2, &kMySemMBox);
		}
		else
		{
			printk("th1 waiting return to sem\n");
		}

		size = 10;
		memcpy(buffer, text, size-1);
		buffer[size-1] = '\0';

		sendMsg.info = size;
		sendMsg.size = size;
		sendMsg.tx_data = buffer;
#ifdef DATA_MAILBOX
		sendMsg.tx_target_thread = kMailBox2ID;
#endif

		printk("th1 sync put to th2 : %s \n", buffer);
		k_mbox_put(&kMyMailBox, &sendMsg, K_FOREVER);

		if (sendMsg.size < size)
		{
			printk("th1 data stil there\n");
		}

		k_sleep(1000);
	}
}

void MailBox2Thread()
{
	char buffer[100];
	struct k_mbox_msg recvMsg;
	int even = 0;

	k_sleep(2000);
	printk("th2 wake up\n");

	while (1)
	{
		recvMsg.info = 100;
		recvMsg.size = 100;
#ifdef DATA_MAILBOX
		recvMsg.rx_source_thread = kMailBox1ID;
#endif

		if (even % 2)
		{
			k_mbox_get(&kMyMailBox, &recvMsg, buffer, K_FOREVER);

			printk("th2 recv data : %s\n", buffer);

			if (recvMsg.info != recvMsg.size)
			{
				printk("th2 some messages are droped %d %lu\n", recvMsg.info, recvMsg.size);
			}
		}
		else
		{
			k_mbox_get(&kMyMailBox, &recvMsg, NULL, K_FOREVER);

			if (even % 4 == 0)
			{
				k_mbox_data_get(&recvMsg, buffer);
			}
			else
			{
				k_mbox_data_get(&recvMsg, NULL);
			}
		}

		even++;

		printk("\n");

		k_sleep(5000);
	}
}

void MailBox3Thread()
{
	struct k_mbox_msg recvMsg;
	struct k_mem_block recvBlock;

	while (1)
	{
		recvMsg.size = 4096;
#ifdef DATA_MAILBOX
		recvMsg.rx_source_thread = kMailBox1ID;
#endif

		k_mbox_get(&kMyMailBox, &recvMsg, NULL, K_FOREVER);

		k_mbox_data_block_get(&recvMsg, &kMyPoolMBox, &recvBlock, K_FOREVER);

		k_mem_pool_free(&recvBlock);
		k_sleep(5000);
	}
}

K_PIPE_DEFINE(kMyPipe, 16, 4);

void Pipe1Thread()
{
	unsigned char *data = k_malloc(128);
	size_t totalSize = 128;
	size_t n = 0;;

	int rc;

	for (unsigned char i = 0; i < totalSize; i++)
	{
		data[0] = i;
	}

	while (1)
	{
		rc = k_pipe_put(&kMyPipe, data, totalSize, &n, 16, K_NO_WAIT);

		if (rc < 0)
		{
			printk("th1 incomplete sent\n");
		}
		else if (n < totalSize)
		{
			printk("th1 %ld/%ld\n", n, totalSize);
		}
		else
		{
			printk("th1 done\n");
		}

		k_sleep(1000);
	}
}

void Pipe2Thread()
{
	unsigned char buffer[128];
	size_t n;
	int rc;

	while (1)
	{
		rc = k_pipe_get(&kMyPipe, buffer, sizeof(buffer), &n, 16, K_MSEC(100));

		if ((rc < 0) || n < 16)
		{
			printk("th2 incomplete received\n");
		}
		else if (n < 128)
		{
			printk("th2 %ld/128\n", n);
		}
		else
		{
			printk("th2 done\n");
		}


		k_sleep(1000);
	}
}
```

## src/Memory.c
```c
#include "Common.h"
#include "Memory.h"

#ifdef MEMORY_SLAB
K_THREAD_DEFINE(kMem1ID, STACKSIZE, Memory1Thread, NULL, NULL, NULL,
		PRIORITY , 0, K_NO_WAIT);
K_THREAD_DEFINE(kMem2ID, STACKSIZE, Memory2Thread, NULL, NULL, NULL,
		PRIORITY , 0, K_NO_WAIT);
#endif
K_MEM_SLAB_DEFINE(kMySlab, 400, 1, 4);

#ifdef MEMORY_POOL
K_THREAD_DEFINE(kMem3ID, STACKSIZE, Memory3Thread, NULL, NULL, NULL,
		PRIORITY , 0, K_NO_WAIT);
K_THREAD_DEFINE(kMem4ID, STACKSIZE, Memory4Thread, NULL, NULL, NULL,
		PRIORITY , 0, K_NO_WAIT);
#endif
K_MEM_POOL_DEFINE(kMyPool, 64, 4096, 1, 4);

#ifdef MEMORY_HEAP
K_THREAD_DEFINE(kMem5ID, STACKSIZE, Memory5Thread, NULL, NULL, NULL,
		PRIORITY , 0, K_NO_WAIT);
K_THREAD_DEFINE(kMem6ID, STACKSIZE, Memory6Thread, NULL, NULL, NULL,
		PRIORITY , 0, K_NO_WAIT);
#endif

void Memory1Thread()
{
	while (1)
	{
		char* blockPtr = NULL;
		if (!k_mem_slab_alloc(&kMySlab, (void**)&blockPtr, 100))
		{
			memset(blockPtr, 0, 400);
			printk("thread1 get block\n");
			k_sleep(1000);
		}
		else
		{
			printk("thread1 fail to get block\n");
		}

		if (blockPtr != NULL)
		{
			printk("thread1 free block\n");
			k_mem_slab_free(&kMySlab, (void**)&blockPtr);
		}

		k_sleep(1000);
	}
}

void Memory2Thread()
{
	while (1)
	{
		char* blockPtr = NULL;
		if (!k_mem_slab_alloc(&kMySlab, (void**)&blockPtr, 100))
		{
			memset(blockPtr, 0, 400);
			printk("thread2 get block\n");
			k_sleep(2000);
		}
		else
		{
			printk("thread2 fail to get block\n");
		}

		if (blockPtr != NULL)
		{
			printk("thread2 free block\n");
			k_mem_slab_free(&kMySlab, (void**)&blockPtr);
		}
		k_sleep(1000);
	}
}

void Memory3Thread()
{
	while (1)
	{
		struct k_mem_block block;
		memset(&block, 0, sizeof(struct k_mem_block));
		if (!k_mem_pool_alloc(&kMyPool, &block, 4096, 100))
		{
			memset(block.data, 0, 4096);
			printk("thread3 get block\n");
			k_sleep(1000);
		}
		else
		{
			printk("thread3 fail to get block\n");
		}

		if (block.data != NULL)
		{
			printk("thread3 free block\n");
			k_mem_pool_free(&block);
		}

		k_sleep(1000);
	}
}

void Memory4Thread()
{
	while (1)
	{
		struct k_mem_block block;
		memset(&block, 0, sizeof(struct k_mem_block));
		if (!k_mem_pool_alloc(&kMyPool, &block, 4096, 100))
		{
			memset(block.data, 0, 4096);
			printk("thread4 get block\n");
			k_sleep(2000);
		}
		else
		{
			printk("thread4 fail to get block\n");
		}

		if (block.data != NULL)
		{
			printk("thread4 free block\n");
			k_mem_pool_free(&block);
		}

		k_sleep(1000);
	}
}

void Memory5Thread()
{
	while (1)
	{
		char *memPtr = k_malloc(4096);
		if (memPtr != NULL)
		{
			memset(memPtr, 0, 4096);
			printk("thread5 get block\n");
			k_sleep(1000);
		}
		else
		{
			printk("thread5 fail to get block\n");
		}

		if (memPtr != NULL)
		{
			k_free(memPtr);
		}
		
		k_sleep(1000);
	}
}

void Memory6Thread()
{
	while (1)
	{
		char *memPtr = k_malloc(4096);
		if (memPtr != NULL)
		{
			memset(memPtr, 0, 4096);
			printk("thread6 get block\n");
			k_sleep(2000);
		}
		else
		{
			printk("thread6 fail to get block\n");
		}

		if (memPtr != NULL)
		{
			k_free(memPtr);
		}

		k_sleep(1000);
	}
}
```

## src/Sync.c
```c
#include "Common.h"
#include "Sync.h"


#ifdef SYNC_SEMA
K_THREAD_DEFINE(kSync1ID, STACKSIZE, Sync1Thread, NULL, NULL, NULL,
		PRIORITY , 0, K_NO_WAIT);
K_THREAD_DEFINE(kSync2ID, STACKSIZE, Sync2Thread, NULL, NULL, NULL,
		PRIORITY , 0, K_NO_WAIT);
#endif
K_SEM_DEFINE(kMySem, 0, 1);

#ifdef SYNC_MUTEX
K_THREAD_DEFINE(kSync3ID, STACKSIZE, Sync3Thread, NULL, NULL, NULL,
		PRIORITY - 2, 0, K_NO_WAIT);
K_THREAD_DEFINE(kSync4ID, STACKSIZE, Sync4Thread, NULL, NULL, NULL,
		PRIORITY - 1, 0, K_NO_WAIT);
K_THREAD_DEFINE(kSync5ID, STACKSIZE, Sync5Thread, NULL, NULL, NULL,
		PRIORITY , 0, K_NO_WAIT);
K_THREAD_DEFINE(kSync6ID, STACKSIZE, Sync6Thread, NULL, NULL, NULL,
		PRIORITY - 2, 0, K_NO_WAIT);
#endif
K_MUTEX_DEFINE(kMyMutex);

#ifdef SYNC_ALERT
K_THREAD_DEFINE(kSync7ID, STACKSIZE, Sync7Thread, NULL, NULL, NULL,
		PRIORITY, 0, K_NO_WAIT);
K_THREAD_DEFINE(kSync8ID, STACKSIZE, Sync8Thread, NULL, NULL, NULL,
		PRIORITY, 0, K_NO_WAIT);
#endif
int AlertHandler(struct k_alert* alert);
K_ALERT_DEFINE(kMyAlert, AlertHandler, 10);

int i = 0;

// producer
void Sync1Thread()
{
	while (1)
	{
		if (kMySem.count == 1) 
		{ 
			printk("count is limit\n");
			k_sleep(1000);
			continue; 
		}

		k_sem_give(&kMySem);
		i++;
		printk("thread1 %d\n", i);
		k_sleep(1000);

		k_sleep(1000);
	}
}

// consumer
void Sync2Thread()
{
	while (1)
	{
		if (!k_sem_take(&kMySem, K_MSEC(50)))
		{
			printk("thread2 %d\n", i);
		}
		else
		{
			printk("thread2 input data not available\n");
		}

		k_sleep(1000);
	}
}

void Sync3Thread()
{
	k_sleep(5000);
	while (1)
	{
		printk("thread3 try lock\n");
		while (k_mutex_lock(&kMyMutex, K_FOREVER)); // waiting lock and donation
		printk("thread3 lock\n");
		printk("thread3 unlock\n");
		k_mutex_unlock(&kMyMutex);

		k_sleep(1000);
	}
}

void Sync4Thread()
{
	while (1)
	{
		printk("thread4\n");

		k_sleep(1000);
	}
}

void Sync5Thread()
{
	while (1)
	{
		printk("thread5 try lock\n");
		k_mutex_lock(&kMyMutex, K_FOREVER);
		printk("thread5 lock\n");
		k_busy_wait(10000000);
		printk("thread5 unlock\n");
		k_mutex_unlock(&kMyMutex);

		k_sleep(1000);
	}
}

void Reentrant(int cnt)
{
	if (cnt < 0) return;
	printk("Reentrant %d\n", cnt);
	while (k_mutex_lock(&kMyMutex, K_FOREVER));
	Reentrant(cnt - 1);
	k_mutex_unlock(&kMyMutex);
}

void Sync6Thread()
{
	while (1)
	{
		Reentrant(10);

		k_sleep(1000);
	}
}

bool tf = true;
int AlertHandler(struct k_alert* alert)
{
	k_sleep(3000);
	if (tf)
	{
		printk("alert %d\n", alert->send_count);
		tf = false;
		return 0;
	}
	else
	{
		printk("pend %d\n", alert->send_count);
		return 1;
	}
}

void Sync7Thread()
{
	while (1)
	{
		k_alert_send(&kMyAlert);
		printk("send alert %d\n", kMyAlert.send_count);
		k_sleep(1000);
	}
}

void Sync8Thread()
{
	while (1)
	{
		printk("wait alert %d\n", kMyAlert.send_count);
		int ret = k_alert_recv(&kMyAlert, K_FOREVER);
		printk("ret = %d, count = %d\n", ret, kMyAlert.send_count);
		k_sleep(900);
		if (kMyAlert.send_count < 3)
		{
			tf = true;
		}
	}
}
```

## src/Thread.c
```c
#include "Common.h"
#include "Thread.h"

#ifdef THREAD
K_THREAD_DEFINE(kPrintID, STACKSIZE, Print1, NULL, NULL, NULL,
		PRIORITY , 0, K_NO_WAIT);
K_THREAD_DEFINE(kWakeUpID, STACKSIZE, WakeUp, NULL, NULL, NULL,
		PRIORITY, 0, K_NO_WAIT);
#endif

int Counting()
{

	u32_t count = 0;

	if (k_is_in_isr())
	{
	}
	else
	{
		count = (u32_t)k_thread_custom_data_get();
		count++;
		k_thread_custom_data_set((void*)count);
	}

	return count;
}

void Print1(void)
{
	k_sched_time_slice_set(10, 5); // init time slice
	while (1)
	{
		printk("test1 %d\n", Counting());
		k_sleep(10000);
	}
}


void WakeUp(void)
{
	while (1)
	{
		printk("wake up %d\n", Counting());
		k_sleep(10000);
	}
}
```

## src/Timer.c
```c
#include "Common.h"
#include "Timer.h"

K_TIMER_DEFINE(kMyTimer, ExpireFunction, NULL);


#ifdef CLOCK
K_THREAD_DEFINE(kKernelClockID, STACKSIZE, KernelClockThread, NULL, NULL, NULL,
		PRIORITY, 0, K_NO_WAIT);
K_THREAD_DEFINE(kHWClockID, STACKSIZE, HWClockThread, NULL, NULL, NULL,
		PRIORITY, 0, K_NO_WAIT);
#endif

void InitTimer()
{
#ifdef TIMER
	k_timer_start(&kMyTimer, K_SECONDS(2), K_SECONDS(10));
#endif
}

void ExpireFunction(struct k_timer* timer)
{
	printk("expire\n");
}

void TimerThread()
{
	while (1)
	{
		k_sleep(1000);
	}
}

void KernelClockThread()
{
	while (1)
	{
		s64_t timeStamp;
		s64_t msSpent;
		
		timeStamp = k_uptime_get();
		k_sleep(5000);

		msSpent = k_uptime_delta(&timeStamp);
		printk("spent : %lld\n", msSpent);
	}
}
void HWClockThread()
{
	while (1)
	{
		u32_t startTime;
		u32_t stopTime;
		u32_t cycleSpent;
		u32_t nsSpent;

		startTime = k_cycle_get_32();
		k_busy_wait(5000000);
		k_sleep(3001);
		stopTime = k_cycle_get_32();

		cycleSpent = stopTime - startTime;
		nsSpent = SYS_CLOCK_HW_CYCLES_TO_NS(cycleSpent);
		printk("cycle : %u, ns : %u\n", cycleSpent, nsSpent);
	}
}
```

## src/WorkQueue.c
```c
#include "Common.h"
#include "WorkQueue.h"

K_THREAD_STACK_DEFINE(kMyStackArea, STACKSIZE);
struct k_work_q kMyWorkQueue;
struct device_info wiMyDevice;
struct device_info wiMyDevice2;

#ifdef WORK_QUEUE
K_THREAD_DEFINE(kWorkQueueID, STACKSIZE, WorkQueueThread, NULL, NULL, NULL,
		PRIORITY, 0, K_NO_WAIT);
#endif

void InitWorkQueue()
{
	k_work_q_start(&kMyWorkQueue, kMyStackArea,
			K_THREAD_STACK_SIZEOF(kMyStackArea), PRIORITY + 1);

	strcpy(wiMyDevice.name, "name");
	strcpy(wiMyDevice2.name, "name");
	k_work_init(&wiMyDevice.work, (k_work_handler_t)PrintError);
	k_work_init(&wiMyDevice2.work, (k_work_handler_t)PrintError2);
}

void PrintError(struct k_work* item)
{
	struct device_info* theDevice = 
		CONTAINER_OF(item, struct device_info, work);

	printk("%s\n", theDevice->name);
}

void PrintError2(struct k_work* item)
{
	struct device_info* theDevice = 
		CONTAINER_OF(item, struct device_info, work);

	printk("%s2\n", theDevice->name);
}

void WorkQueueThread()
{
	while(1)
	{
		k_work_submit_to_queue(&kMyWorkQueue, &wiMyDevice.work);
		k_work_submit_to_queue(&kMyWorkQueue, &wiMyDevice2.work);

		k_sleep(10000);
	}
}
```
